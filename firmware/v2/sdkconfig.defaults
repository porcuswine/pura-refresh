## firmware/v2/sdkconfig.defaults
```kconfig
CONFIG_IDF_TARGET="esp32"
CONFIG_ESPTOOLPY_FLASHMODE_DIO=y
CONFIG_ESPTOOLPY_FLASHFREQ_40M=y
CONFIG_ESPTOOLPY_FLASHSIZE_4MB=y
CONFIG_PARTITION_TABLE_CUSTOM=y
CONFIG_PARTITION_TABLE_CUSTOM_FILENAME="partitions.csv"
CONFIG_PARTITION_TABLE_OFFSET=0x10000
CONFIG_COMPILER_OPTIMIZATION_SIZE=y
CONFIG_ESP_SYSTEM_ESP32_SRAM1_REGION_AS_IRAM=n
CONFIG_ESP32_REV_MIN_0=y
CONFIG_LOG_DEFAULT_LEVEL_WARN=y
CONFIG_ESP_WIFI_NVS_ENABLED=n
CONFIG_NVS_LEGACY_DUP_KEYS_COMPATIBILITY=y
CONFIG_ESP_WIFI_SOFTAP_SUPPORT=y
CONFIG_ESP_MAIN_TASK_STACK_SIZE=6144
```

## firmware/v3/sdkconfig.defaults
```kconfig
CONFIG_IDF_TARGET="esp32"
CONFIG_ESPTOOLPY_FLASHMODE_DIO=y
CONFIG_ESPTOOLPY_FLASHFREQ_40M=y
CONFIG_ESPTOOLPY_FLASHSIZE_16MB=y
CONFIG_PARTITION_TABLE_CUSTOM=y
CONFIG_PARTITION_TABLE_CUSTOM_FILENAME="partitions.csv"
CONFIG_PARTITION_TABLE_OFFSET=0x10000
CONFIG_COMPILER_OPTIMIZATION_SIZE=y
CONFIG_ESP_SYSTEM_ESP32_SRAM1_REGION_AS_IRAM=n
CONFIG_ESP32_REV_MIN_0=y
CONFIG_LOG_DEFAULT_LEVEL_WARN=y
CONFIG_ESP_WIFI_NVS_ENABLED=n
CONFIG_NVS_LEGACY_DUP_KEYS_COMPATIBILITY=y
CONFIG_ESP_WIFI_SOFTAP_SUPPORT=y
CONFIG_ESP_MAIN_TASK_STACK_SIZE=6144

CONFIG_SPIRAM=n

# Legacy Pura V3 stock tables contain no MD5 trailer. Read without requiring it.
CONFIG_PARTITION_TABLE_MD5=n
```
